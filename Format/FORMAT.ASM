M0000	EQU	0000H
M0008	EQU	0008H
M0020	EQU	0020H
M0023	EQU	0023H
M0033	EQU	0033H
M0040	EQU	0040H
M0060	EQU	0060H
M00BA	EQU	00BAH
M00CD	EQU	00CDH
M0100	EQU	0100H
M0206	EQU	0206H
M0A0D	EQU	0A0DH
M1000	EQU	1000H
M1720	EQU	1720H
M199D	EQU	199DH
M1C0D	EQU	1C0DH
M1D0D	EQU	1D0DH
M332D	EQU	332DH
M332E	EQU	332EH
M37B6	EQU	37B6H
M37E1	EQU	37E1H
M37EC	EQU	37ECH
M37EE	EQU	37EEH
M37EF	EQU	37EFH
M3840	EQU	3840H
M3A0D	EQU	3A0DH
M4030	EQU	4030H
M41FC	EQU	41FCH
M4200	EQU	4200H
M4202	EQU	4202H
M4275	EQU	4275H
M429A	EQU	429AH
M42AA	EQU	42AAH
M42B2	EQU	42B2H
M42E2	EQU	42E2H
M42E5	EQU	42E5H
M42F1	EQU	42F1H
M430F	EQU	430FH
M440D	EQU	440DH
M4467	EQU	4467H
M460D	EQU	460DH
M4820	EQU	4820H
M4D00	EQU	4D00H
M4D16	EQU	4D16H
M4DFF	EQU	4DFFH
M4E0D	EQU	4E0DH
M4E20	EQU	4E20H
	ORG	5200H
M5200	DI
	LD	SP,M41FC
	PUSH	HL
	LD	A,(M4030)
	CP	0C7H
	JR	Z,M521C
	LD	A,(M430F)
	BIT	5,A
	JR	Z,M521C
	LD	HL,M57C0
	CALL	M4467
	JP	M4030
M521C	LD	HL,M5E00
	LD	DE,M4200
	LD	BC,M0100
	LDIR
	LD	HL,M57E8
	CALL	M429A
	POP	HL
M522E	LD	HL,M580E	; ask "WHICH DRIVE IS TO BE USED ?"
	CALL	M429A
	LD	HL,M5D00
	LD	B,01H
	CALL	M0040
	LD	A,(HL)
	SUB	'0'
	JP	C,M522E
	CP	04H
	JP	NC,M522E
	RLCA
	RLCA
	RLCA
	OR	0C7H
	LD	(M5251),A
	XOR	A
	SET	0,A
M5251	EQU	$-1
	LD	(M5768),A
	CALL	M5767
	CALL	M5754
	LD	BC,M0000
	CALL	M0060
M5261	LD	A,(M37EC)
	BIT	0,A
	JR	NZ,M5261
	LD	HL,M586B
	BIT	7,A
	JP	NZ,M56AD
	LD	HL,M5896
	BIT	2,A
	JP	Z,M56AD
M5278	LD	HL,M582B	; ask "DISKETTE NAME ?"
	CALL	M429A
	LD	HL,M5778
	LD	DE,M5CD0
	LD	BC,M0008
	LDIR
	LD	HL,M5D00
	LD	B,08H
	CALL	M0040
	LD	A,B
	OR	A
	JR	Z,M5278
	LD	C,B
	LD	B,00H
	LD	DE,M5CD0
	LDIR
M529D	LD	HL,M583C	; ask "CREATION DATE MM/DD/YY) ?"
	CALL	M429A
	LD	HL,M5D00
	LD	B,08H
	CALL	M0040
	LD	A,B
	CP	08H
	JP	NZ,M529D
	LD	A,(M5D02)
	CP	'/'
	JP	NZ,M529D
	LD	A,(M5D05)
	CP	'/'
	JP	NZ,M529D
	LD	C,B
	LD	B,00H
	LD	DE,M5CD8
	LD	HL,M5D00
	LDIR
M52CC	LD	HL,M5858	; ask "MASTER PASSWORD ?"
	CALL	M429A
	LD	HL,M5D00
	LD	B,08H
	CALL	M0040
	LD	A,B
	OR	A
	JR	Z,M52CC
	EX	DE,HL
	ADD	A,E
	LD	L,A
	LD	A,D
	ADC	A,00H
	LD	H,A
	LD	A,08H
	SUB	B
	LD	B,A
M52E9	LD	(HL),' '
	INC	HL
	DJNZ	M52E9
	CALL	M52F6
	LD	(M5CCE),HL
	JR	M5322
M52F6	LD	HL,MFFFF
	LD	B,08H
	LD	A,E
	ADD	A,07H
	LD	E,A
	JR	NC,M5302
	INC	D
M5302	LD	A,(DE)
	PUSH	DE
	LD	D,A
	LD	E,H
	LD	A,L
	AND	07H
	RRCA
	RRCA
	RRCA
	XOR	L
	LD	L,A
	LD	H,00H
	ADD	HL,HL
	ADD	HL,HL
	ADD	HL,HL
	ADD	HL,HL
	XOR	H
	XOR	D
	LD	D,A
	LD	A,L
	ADD	HL,HL
	XOR	H
	XOR	E
	LD	E,A
	EX	DE,HL
	POP	DE
	DEC	DE
	DJNZ	M5302
	RET
M5322	LD	HL,M5C00
	XOR	A
M5326	LD	(HL),0FCH
	INC	HL
	INC	A
	CP	'#'
	JR	NZ,M5326
M532E	CP	0CBH
	JR	Z,M533E
	LD	(HL),0FFH
	INC	HL
	INC	A
	JR	M532E
M5338	LD	HL,M5963
	CALL	M429A
M533E	LD	HL,M5926	; ask "DO YOU WANT TO LOCK OUT ANY TRACKS ?"
	CALL	M429A
	LD	HL,M5D00
	LD	B,03H
	CALL	M0040
	LD	A,(HL)
	CP	'Y'
	JR	NZ,M539E
	LD	HL,M594C
	CALL	M429A
	LD	HL,M5D00
	LD	B,1EH
	CALL	M0040
M535F	CALL	M5733
	LD	D,E
	CP	'-'
	JR	NZ,M536A
	CALL	M5733
M536A	EX	AF,AF'
	LD	A,D
	OR	A
	JR	Z,M5338
	CP	'#'
	JR	NC,M5338
	LD	A,E
	CP	'#'
	JR	NC,M5338
	SUB	D
	JR	C,M5338
	INC	A
	LD	B,A
	PUSH	HL
	LD	L,D
	LD	H,'\'
M5381	LD	(HL),0FFH
	INC	HL
	DJNZ	M5381
	POP	HL
	EX	AF,AF'
	CP	0DH
	JR	NZ,M535F
	LD	HL,M5979
	CALL	M429A
	LD	HL,M5D00
	LD	B,03H
	CALL	M0040
	LD	A,(HL)
	LD	(M548D),A
M539E	CALL	M5767
	LD	BC,M0000
	CALL	M0060
	LD	A,(M37EC)
	LD	HL,M586B
	BIT	7,A
	JP	NZ,M56AD
	LD	HL,M5896
	BIT	2,A
	JP	Z,M56AD
	LD	HL,M587C
	BIT	6,A
	JP	NZ,M56AD
	LD	BC,M00CD
	LD	HL,M58AB

M53C8	DEC	BC
	LD	A,B
	OR	C
	JP	Z,M56AD
	LD	A,(M37EC)
	AND	02H
	JR	NZ,M53C8
	LD	BC,M199D
	LD	HL,M58C1

M53DB	DEC	BC
	LD	A,B
	OR	C
	JP	Z,M56AD
	LD	A,(M37EC)
	AND	02H
	JR	Z,M53DB
	LD	DE,M0000
	LD	BC,M00BA
	LD	HL,M58AB

M53F1	DEC	BC
	LD	A,B
	OR	C
	JP	Z,M56AD
	INC	DE
	LD	A,(M37EC)
	AND	02H
	JR	NZ,M53F1
	LD	BC,M1720
	LD	HL,M58C1

M5405	DEC	BC
	LD	A,B
	OR	C
	JP	Z,M56AD
	INC	DE
	LD	A,(M37EC)
	AND	02H
	JR	Z,M5405
	LD	HL,MEACB
	ADD	HL,DE
	LD	HL,M58DB	; DISKETTE UNUSABLE! HARD SECTORED!\n
;	JP	NC,M56AD
	NOP
	NOP
	NOP
	CALL	M5767
M5420	LD	BC,M5D00
	LD	DE,M0000
	CALL	M42AA
	CALL	Z,M5B9C
	NOP
	NOP
	NOP
	LD	H,'\'
	LD	L,11H
	LD	C,00H
M5435	LD	A,(HL)
	CP	0FCH
	JR	Z,M5452
	INC	C
	LD	A,C
	RRCA
	LD	A,L
	JR	NC,M5448
	ADD	A,C
	LD	L,A
	CP	'#'
	JR	NZ,M5435
	JR	M544C
M5448	SUB	C
	LD	L,A
	JR	NZ,M5435
M544C	LD	HL,M5998
	JP	M56AD
M5452	LD	A,L
	LD	(M4202),A
	CALL	M5726
	LD	(M59EB),BC
	LD	HL,M59C9
	CALL	M429A
	XOR	A
	LD	(M54B1),A
M5467	LD	A,(M54B1)
	CALL	M5726
	LD	(M5A26),BC
	LD	HL,M5A14
	CALL	M429A
	LD	A,(M54B1)
	LD	B,A
	LD	A,(M4202)
	CP	B
	LD	B,0FAH
	JR	Z,M5495
	LD	L,A
	LD	H,'\'
	LD	A,(HL)
	INC	A
	LD	B,0FBH
	JR	NZ,M5495
	LD	A,00H
M548D	EQU	$-1
	CP	'Y'
	JP	NZ,M5502
	LD	B,0F9H
M5495	LD	A,B
	LD	(M54DB),A
	LD	HL,M5F00
	LD	DE,M576D
	LD	B,0EH
	CALL	M5749
M54A4	LD	B,06H
	LD	C,00H
	CALL	M574B
	LD	C,0FEH
	CALL	M5751
	LD	C,00H
M54B1	EQU	$-1
	CALL	M5751
	LD	C,00H
	CALL	M5751
	LD	A,(DE)
	LD	C,A
	CALL	M5751
	LD	C,01H
	CALL	M5751
	LD	C,0F7H
	CALL	M5751
	LD	C,0FFH
	CALL	M5751
	LD	B,0BH
	CALL	M5749
	LD	B,06H
	LD	C,00H
	CALL	M574B
	LD	C,00H
M54DB	EQU	$-1
	CALL	M5751
	LD	B,00H
	LD	C,0E5H
	CALL	M574B
	LD	C,0F7H
	CALL	M5751
	LD	C,0FFH
	CALL	M5751
	LD	B,0BH
	CALL	M5749
	INC	DE
	LD	A,(DE)
	INC	A
	JR	NZ,M54A4
	LD	B,'['
	CALL	M5749
	CALL	M551F
M5502	LD	A,(M54B1)
	INC	A
	LD	(M54B1),A
	CP	'#'
	JR	Z,M556B
	LD	A,'['
	LD	(M37EC),A
	PUSH	AF
	POP	AF
	PUSH	AF
	POP	AF
M5516	LD	A,(M37EC)
	RRCA
	JR	C,M5516
	JP	M5467
M551F	CALL	M5523
	RET	Z

M5523	CALL	M5767
	LD	BC,M5F00
	LD	HL,M37EC
	LD	(HL),0F4H
	LD	DE,M37EF
	PUSH	BC
	POP	BC
	PUSH	BC
	POP	BC
	DI
	JR	M553B
M5538	RRCA
	JR	NC,M5546
M553B	LD	A,(HL)
	BIT	1,A
	JR	Z,M5538
	LD	A,(BC)
	LD	(DE),A
	INC	BC
	JP	M553B
M5546	LD	A,(HL)
	LD	(HL),0D0H
	LD	HL,M5A29
	BIT	2,A
	JP	NZ,M56AD
	LD	HL,MA100
	ADD	HL,BC
	EX	DE,HL
	LD	HL,MF413
	ADD	HL,DE
	LD	HL,M5A55
	JP	NC,M56AD
	LD	HL,MF397
	ADD	HL,DE
	LD	HL,M5A7A
;	JP	C,M56AD		; drive motor too fast
	NOP
	NOP
	NOP
	RET

M556B	LD	A,0DH
	CALL	M0033
	LD	D,00H
M5572	LD	L,D
	LD	H,'\'
	LD	A,(HL)
	INC	A
	JP	Z,M55BD
	LD	A,D
	CALL	M5726
	LD	(M5AB0),BC
	LD	E,00H
M5584	PUSH	DE
	LD	A,D
	CALL	M5767
	LD	A,E
	CALL	M5726
	LD	(M5ABB),BC
	LD	HL,M5A9F
	CALL	M429A
	POP	DE
	LD	BC,M5D00
	CALL	M42AA
	LD	HL,M5ABE
	BIT	4,A
	JP	NZ,M5719
	LD	HL,M5ADD
	BIT	3,A
	JP	NZ,M5719
	LD	HL,M5AFC
	BIT	2,A
	JP	NZ,M56AD
	INC	E
	LD	A,E
	CP	0AH
	JP	NZ,M5584
M55BD	INC	D
	LD	A,D
	CP	'#'
	JP	NZ,M5572
	LD	HL,M5C00
	LD	DE,M5C60
	LD	BC,M0023
	LDIR
	LD	HL,M5B28
	CALL	M429A
	LD	HL,M5C00
	LD	A,(HL)
	OR	01H
	LD	(HL),A
	LD	A,(M4202)
	LD	(M57B6),A
	LD	L,A
	LD	H,'\'
	LD	A,(HL)
	INC	A
	JP	Z,M56D1
	LD	(HL),0FFH
	LD	DE,M0000
	LD	BC,M4200
	LD	A,0A8H
	CALL	M56BD
	LD	A,(M37EC)
	AND	'`'
	JP	NZ,M56CB
	LD	BC,M5C00
	LD	A,(M4202)
	LD	D,A
	LD	E,00H
	LD	A,0A9H
	CALL	M56BD
	LD	A,(M37EC)
	AND	'`'
	CP	' '
	JP	NZ,M56CB
	LD	HL,M5D00
M561A	LD	(HL),00H
	INC	L
	JR	NZ,M561A
	LD	(HL),0A2H
	INC	HL
	LD	(HL),','
	DEC	HL
	LD	E,01H
	LD	BC,M5D00
	LD	A,0A9H
	CALL	M56BD
	LD	A,(M37EC)
	AND	'`'
	CP	' '
	JP	NZ,M56CB
	LD	DE,M5D00
	LD	HL,M5780
	LD	BC,M0020
	LDIR
	LD	A,(M4202)
	LD	D,A
	LD	E,02H
	LD	BC,M5D00
	LD	A,0A9H
	CALL	M56BD
	LD	A,(M37EC)
	AND	'`'
	CP	' '
	JP	NZ,M56CB
	LD	HL,M57A0
	LD	DE,M5D00
	LD	BC,M0020
	LDIR
	LD	A,(M4202)
	LD	D,A
	LD	E,03H
	LD	BC,M5D00
	LD	A,0A9H
	CALL	M56BD
	LD	A,(M37EC)
	AND	'`'
	CP	' '
	JP	NZ,M56CB
	LD	HL,M5D00
	LD	B,' '
M5684	LD	(HL),00H
	INC	HL
	DJNZ	M5684
	LD	A,(M4202)
	LD	D,A
	LD	E,04H
M568F	LD	BC,M5D00
	LD	A,0A9H
	CALL	M56BD
	LD	A,(M37EC)
	AND	'`'
	CP	' '
	JP	NZ,M56CB
	INC	E
	LD	A,E
	CP	0AH
	JR	NZ,M568F
	CALL	M5754
	LD	HL,M5B6D
M56AD	CALL	M429A
M56B0	LD	HL,M5B82
	CALL	M429A
M56B6	LD	A,(M3840)
	RRCA
	JR	NC,M56B6
	HALT
M56BD	CALL	M56D7
	JR	NZ,M56CB
	PUSH	BC
	LD	BC,M5D00
	CALL	M42AA
	POP	BC
	RET	Z
M56CB	LD	HL,M5B49
	JP	M56AD
M56D1	LD	HL,M59EE
	JP	M56AD
M56D7	LD	(M56F8),A
	PUSH	BC
	CALL	M56E2
	POP	HL
	RET	Z
	LD	B,H
	LD	C,L
M56E2	LD	(M37EE),DE
	PUSH	DE
	CALL	M5767
	LD	HL,M37EC
	LD	(HL),1BH
	PUSH	AF
	POP	AF
	PUSH	AF
	POP	AF
M56F3	LD	A,(HL)
	RRCA
	JR	C,M56F3
	LD	(HL),00H
M56F8	EQU	$-1
	LD	DE,M37EF
	PUSH	BC
	POP	BC
	PUSH	BC
	POP	BC
	DI
	JR	M5706
M5703	RRCA
	JR	NC,M5711
M5706	LD	A,(HL)
	BIT	1,A
	JR	Z,M5703
	LD	A,(BC)
	LD	(DE),A
M570D	INC	BC
	JP	M5706
M5711	LD	A,(HL)
	AND	'|'
	POP	DE
	RET	Z
	LD	(HL),0D0H
	RET
M5719	PUSH	DE
	CALL	M429A
	POP	DE
	LD	L,D
	LD	H,'\'
	LD	(HL),0FFH
	JP	M55BD
M5726	LD	C,'0'
M5728	SUB	0AH
	JR	C,M572F
	INC	C
	JR	M5728
M572F	ADD	A,':'
	LD	B,A
	RET

M5733	LD	E,00H
M5735	LD	A,(HL)
	INC	HL
	CP	'0'
	RET	C
	CP	':'
	RET	NC
	SUB	'0'
	LD	B,A
	LD	A,E
	ADD	A,A
	ADD	A,A
	ADD	A,E
	ADD	A,A
	ADD	A,B
	LD	E,A
	JR	M5735
M5749	LD	C,0FFH
M574B	CALL	M5751
	DJNZ	M574B
	RET

M5751	LD	(HL),C
	INC	HL
	RET

M5754	CALL	M5767
	LD	A,0BH
	LD	(M37EC),A
	PUSH	AF
	POP	AF
	PUSH	AF
	POP	AF
M5760	LD	A,(M37EC)
	RRCA
	JR	C,M5760
	RET
	
M5767	LD	A,00H
M5768	EQU	$-1
	LD	(M37E1),A
	RET

M576D	NOP
	DEC	B
	LD	BC,M0206
	RLCA
	INC	BC
	EX	AF,AF'
	INC	B
	ADD	HL,BC
	RST	38H
M5778	DB	'        '
M5780	DB	5Eh,0,0,0,0
	DB	'BOOT    SYS'
	DB	60h,7Fh,1Fh,0B2h,5,0,0,0
	DB	0FFh,0FFh,0,0,0,0,0,0

M57A0	DB	5Dh,0,0,0,0,'DIR     SYS'
	DB	0A7h,1Dh,0F9h,0E5h,0Ah,0
M57B6	DB	11h,1,0FFh,0FFh,0,0,0,0,0,0

M57C0	DB	'FORMAT INVALID DURING PROGRAM CHAINING!',13
M57E8	DB	1Ch,1Fh,'TRSDOS DISK FORMATTER PROGRAM  2.3',13,10
M580E	DB	'WHICH DRIVE IS TO BE USED ? ',3
M582B	DB	'DISKETTE NAME ? ',3
M583C	DB	'CREATION DATE (MM/DD/YY) ? ',3

M5858	DB	'MASTER PASSWORD ? ',3
M586B	DB	'DRIVE NOT READY!',13
M587C	DB	'WRITE PROTECTED DISKETTE!',13
M5896	DB	'DRIVE NOT IN SYSTEM!',13
M58AB	DB	'NO DISKETTE IN DRIVE!',13
M58C1	DB	'DOOR NOT CLOSED ON DRIVE!',13
M58DB	DB	'DISKETTE UNUSABLE! HARD SECTORED!',13
M58FD	DB	'DISKETTE CONTAINS DATA, FORMAT OR NOT ? ',3
M5926	DB	'DO YOU WANT TO LOCK OUT ANY TRACKS ? ',3
M594C	DB	'WHICH TRACKS (1-34) ? ',3
M5963	DB	'INVALID TRACK NUMBER!',13
M5979	DB	'FORMAT THE LOCKED OUT TRACKS? ',3
M5998	DB	'CAN',27h,'T FORMAT, NO TRACKS AVAILABLE FOR DIRECTORY!',13
M59C9	DB	'DIRECTORY WILL BE PLACED ON TRACK '
M59EB	DB	'00',13
M59EE	DB	'C'		; CAN'T FORMAT, DIRECTORY TRACK FLAWED!\n
	LD	B,C
	LD	C,(HL)
	DAA
M59F2	LD	D,H
	JR	NZ,M5A3B
M59F5	LD	C,A
	LD	D,D
	LD	C,L
	LD	B,C
	LD	D,H
	INC	L
M59FB	JR	NZ,M5A41
	LD	C,C
M59FE	LD	D,D
	LD	B,L
	LD	B,E
M5A01	LD	D,H
	LD	C,A
M5A03	LD	D,D
	LD	E,C
	JR	NZ,M5A5B
	LD	D,D
	LD	B,C
	LD	B,E
	LD	C,E
	JR	NZ,M5A53
	LD	C,H
	LD	B,C
	LD	D,A
	LD	B,L
	LD	B,H
	LD	HL,M1D0D
M5A14	EQU	$-1		; FORMATTING TRACK 00\n
	LD	B,(HL)
	LD	C,A
	LD	D,D
	LD	C,L
	LD	B,C
	LD	D,H
M5A1B	LD	D,H
M5A1C	LD	C,C
	LD	C,(HL)
	LD	B,A
	JR	NZ,M5A75
	LD	D,D
	LD	B,C
	LD	B,E
	LD	C,E
	JR	NZ,M5A57
M5A26	EQU	$-1
	JR	NC,M5A2C
M5A29	LD	A,(BC)
	LD	B,E		; CAN'T FORMAT, DISK TRANSFER RATE TOO FAST!\r\n
M5A2B	LD	B,C
M5A2C	LD	C,(HL)
	DAA
	LD	D,H
	JR	NZ,M5A77
	LD	C,A
M5A32	LD	D,D
	LD	C,L
	LD	B,C
	LD	D,H
	INC	L
	JR	NZ,M5A7D
	LD	C,C
M5A3A	LD	D,E
M5A3B	LD	C,E
	JR	NZ,M5A92
	LD	D,D
	LD	B,C
	LD	C,(HL)
M5A41	LD	D,E
	LD	B,(HL)
	LD	B,L
	LD	D,D
	JR	NZ,M5A99
	LD	B,C
	LD	D,H
	LD	B,L
	JR	NZ,M5AA0
	LD	C,A
	LD	C,A
	JR	NZ,M5A96
	LD	B,C
	LD	D,E
	LD	D,H
M5A53	LD	HL,M0A0D
M5A55	EQU	$-1		; CAN'T FORMAT MOTOR SPEED TOO SLOW!\r\n
	LD	B,E
M5A57	LD	B,C
	LD	C,(HL)
	DAA
	LD	D,H
M5A5B	JR	NZ,M5AA3
	LD	C,A
	LD	D,D
	LD	C,L
	LD	B,C
	LD	D,H
	INC	L
	JR	NZ,M5AB2
	LD	C,A
	LD	D,H
	LD	C,A
	LD	D,D
	JR	NZ,M5ABE
	LD	D,B
	LD	B,L
	LD	B,L
	LD	B,H
	JR	NZ,M5AC5
	LD	C,A
	LD	C,A
	JR	NZ,M5AC8
M5A75	LD	C,H
	LD	C,A
M5A77	LD	D,A
	LD	HL,M0A0D
M5A7A	EQU	$-1		; CAN'T FORMAT, MOTOR SPEED TOO FAST!\r
	LD	B,E
	LD	B,C
M5A7D	LD	C,(HL)
	DAA
	LD	D,H
	JR	NZ,M5AC8
	LD	C,A
	LD	D,D
	LD	C,L
	LD	B,C
	LD	D,H
	INC	L
	JR	NZ,M5AD7
	LD	C,A
	LD	D,H
	LD	C,A
	LD	D,D
	JR	NZ,M5AE3
	LD	D,B
	LD	B,L
M5A92	LD	B,L
	LD	B,H
	JR	NZ,M5AEA
M5A96	LD	C,A
	LD	C,A
	JR	NZ,M5AE0
M5A99	EQU	$-1
	LD	B,C
	LD	D,E
	LD	D,H
	LD	HL,M1D0D
M5A9F	EQU	$-1		;  VERIFYING TRACK 00, SECTOR 00
M5AA0	LD	D,(HL)
	LD	B,L
	LD	D,D
M5AA3	LD	C,C
	LD	B,(HL)
	LD	E,C
	LD	C,C
	LD	C,(HL)
	LD	B,A
	JR	NZ,M5AFF
	LD	D,D
	LD	B,C
	LD	B,E
	LD	C,E
	JR	NZ,M5AE1
M5AB0	EQU	$-1
	JR	NC,M5ADF
M5AB2	EQU	$-1
	JR	NZ,M5B08
	LD	B,L
	LD	B,E
	LD	D,H
	LD	C,A
	LD	D,D
	JR	NZ,M5AEC
M5ABB	EQU	$-1
	JR	NC,M5AC1
M5ABE	LD	A,(M4E20)	; ' NOT FOUND! TRACK LOCKED OUT!\n: '
M5AC1	LD	C,A
	LD	D,H
	JR	NZ,M5B0B
M5AC5	LD	C,A
	LD	D,L
	LD	C,(HL)
M5AC8	LD	B,H
	LD	HL,M5420
	LD	D,D
	LD	B,C
	LD	B,E
	LD	C,E
	JR	NZ,M5B1E
	LD	C,A
	LD	B,E
	LD	C,E
	LD	B,L
	LD	B,H
M5AD7	JR	NZ,M5B28
	LD	D,L
	LD	D,H
	LD	HL,M3A0D
M5ADD	EQU	$-1
	JR	NZ,M5B23
M5ADF	EQU	$-1		; 'CRC ERROR! TRACK LOCKED OUT!\r\n'
M5AE0	LD	D,D
M5AE1	LD	B,E
	JR	NZ,M5B29
M5AE3	EQU	$-1
	LD	D,D
	LD	D,D
	LD	C,A
	LD	D,D
	LD	HL,M5420
M5AEA	EQU	$-1
	LD	D,D
M5AEC	LD	B,C
	LD	B,E
	LD	C,E
	JR	NZ,M5B3D
	LD	C,A
	LD	B,E
	LD	C,E
	LD	B,L
	LD	B,H
	JR	NZ,M5B47
	LD	D,L
	LD	D,H
	LD	HL,M0A0D
M5AFC	EQU	$-1		; 'CAN'T VERIFY, DISK TRANSFER RATE TOO FAST!\r\n'
	LD	B,E
	LD	B,C
M5AFF	LD	C,(HL)
	DAA
	LD	D,H
	JR	NZ,M5B5A
	LD	B,L
	LD	D,D
	LD	C,C
	LD	B,(HL)
M5B08	LD	E,C
	INC	L
	JR	NZ,M5B50
M5B0B	EQU	$-1
	LD	C,C
	LD	D,E
	LD	C,E
	JR	NZ,M5B65
	LD	D,D
	LD	B,C
	LD	C,(HL)
	LD	D,E
	LD	B,(HL)
	LD	B,L
	LD	D,D
	JR	NZ,M5B6C
	LD	B,C
	LD	D,H
	LD	B,L
	JR	NZ,M5B73
M5B1E	EQU	$-1
	LD	C,A
	LD	C,A
	JR	NZ,M5B69
M5B23	LD	B,C
	LD	D,E
	LD	D,H
	LD	HL,M0A0D
M5B28	EQU	$-1		; 'INITIALIZING SYSTEM INFORMATION\n'
M5B29	LD	C,C
	LD	C,(HL)
	LD	C,C
	LD	D,H
	LD	C,C
	LD	B,C
	LD	C,H
	LD	C,C
	LD	E,D
	LD	C,C
	LD	C,(HL)
	LD	B,A
	JR	NZ,M5B8A
	LD	E,C
	LD	D,E
	LD	D,H
	LD	B,L
	LD	C,L
	JR	NZ,M5B87
M5B3D	EQU	$-1
	LD	C,(HL)
	LD	B,(HL)
	LD	C,A
	LD	D,D
	LD	C,L
	LD	B,C
	LD	D,H
	LD	C,C
	LD	C,A
M5B47	LD	C,(HL)
	DEC	C
M5B49	LD	B,E		; 'CAN'T INITIALZIE SYSTEM INFORMATION\r'
	LD	B,C
	LD	C,(HL)
	DAA
	LD	D,H
	JR	NZ,M5B99
M5B50	LD	C,(HL)
	LD	C,C
	LD	D,H
	LD	C,C
	LD	B,C
	LD	C,H
	LD	C,C
	LD	E,D
	LD	B,L
	JR	NZ,M5BAE
M5B5A	EQU	$-1
	LD	E,C
	LD	D,E
	LD	D,H
	LD	B,L
	LD	C,L
	JR	NZ,M5BAB
	LD	C,(HL)
	LD	B,(HL)
	LD	C,A
M5B65	LD	D,D
	LD	C,L
	LD	B,C
	LD	D,H
M5B69	LD	C,C
	LD	C,A
	LD	C,(HL)
M5B6C	DEC	C
M5B6D	LD	A,(BC)		; '\nFORMATINING COMPLETE\r\n\nHIT 'ENTER' TO CONTINUE\r'
	LD	B,(HL)
	LD	C,A
	LD	D,D
	LD	C,L
	LD	B,C
M5B73	LD	D,H
	LD	D,H
	LD	C,C
	LD	C,(HL)
	LD	B,A
	JR	NZ,M5BBD
	LD	C,A
	LD	C,L
	LD	D,B
	LD	C,H
	LD	B,L
	LD	D,H
	LD	B,L
	DEC	C
M5B82	LD	A,(BC)
	LD	A,(BC)
	LD	C,B
	LD	C,C
	LD	D,H
M5B87	JR	NZ,M5BB0
	LD	B,L
M5B8A	LD	C,(HL)
	LD	D,H
	LD	B,L
	LD	D,D
	DAA
	JR	NZ,M5BE5
	LD	C,A
	JR	NZ,M5BD7
	LD	C,A
	LD	C,(HL)
	LD	D,H
	LD	C,C
	LD	C,(HL)
M5B99	LD	D,L
	LD	B,L
	DEC	C
M5B9C	EQU	5B9CH
M5BAB	EQU	5BABH
M5BAE	EQU	5BAEH
M5BB0	EQU	5BB0H
M5BBD	EQU	5BBDH
M5BC0	EQU	5BC0H
M5BD7	EQU	5BD7H
M5BE5	EQU	5BE5H
M5C00	EQU	5C00H
M5C60	EQU	5C60H
	ORG	5CCBH
	LD	HL,M0000
M5CCE	NOP
	NOP
M5CD0	JR	NZ,M5CF2
	JR	NZ,M5CF4
	JR	NZ,M5CF6
	JR	NZ,M5CF8
M5CD8	LD	C,L
	LD	C,L
	CPL
	LD	B,H
	LD	B,H
	CPL
	LD	E,C
	LD	E,C
	DEC	C
	JR	NZ,M5D03
	JR	NZ,M5D05
	JR	NZ,M5D07
	JR	NZ,M5D09
	JR	NZ,M5D0B
	JR	NZ,M5D0D
	JR	NZ,M5D0F
	JR	NZ,M5D11
	JR	NZ,M5D13
M5CF2	EQU	$-1
	JR	NZ,M5D15
M5CF4	EQU	$-1
	JR	NZ,M5D17
M5CF6	EQU	$-1
	JR	NZ,M5D19
M5CF8	EQU	$-1
	JR	NZ,M5D1B
	JR	NZ,M5D1D
	JR	NZ,M5D1F
	DB	20H
M5D00	EQU	5D00H
M5D02	EQU	5D02H
M5D03	EQU	5D03H
M5D05	EQU	5D05H
M5D07	EQU	5D07H
M5D09	EQU	5D09H
M5D0B	EQU	5D0BH
M5D0D	EQU	5D0DH
M5D0F	EQU	5D0FH
M5D11	EQU	5D11H
M5D13	EQU	5D13H
M5D15	EQU	5D15H
M5D17	EQU	5D17H
M5D19	EQU	5D19H
M5D1B	EQU	5D1BH
M5D1D	EQU	5D1DH
M5D1F	EQU	5D1FH
	ORG	5E00H
M5E00	NOP
	CP	00H
	DI
	LD	SP,M41FC
	LD	HL,M42E2
	CALL	M429A
	LD	A,01H
	LD	(M37E1),A
	LD	A,(M4202)
	LD	D,A
	LD	E,04H
	LD	BC,M4D00
	CALL	M42AA
	JR	NZ,M5E90
	LD	A,(M4D00)
	AND	10H
	LD	HL,M42E5
	JR	Z,M5E93
	EXX
	LD	HL,(M4D16)
	LD	D,L
	LD	A,H
	RLCA
	RLCA
	RLCA
	AND	07H
	LD	H,A
	RLCA
	RLCA
	ADD	A,H
	LD	E,A
	LD	BC,M4DFF
	EXX
M5E3E	CALL	M4275
	DEC	A
	JR	NZ,M5E5B
	CALL	M4275
	LD	B,A
	CALL	M4275
	LD	L,A
	DEC	B
	CALL	M4275
	LD	H,A
M5E51	DEC	B
	JR	Z,M5E3E
	CALL	M4275
	LD	(HL),A
	INC	HL
	JR	M5E51
M5E5B	DEC	A
	JR	Z,M5E69
	CALL	M4275
	LD	B,A
M5E62	CALL	M4275
	DJNZ	M5E62
	JR	M5E3E
M5E69	CALL	M4275
	CALL	M4275
	LD	L,A
	CALL	M4275
	LD	H,A
	JP	(HL)
	EXX
	INC	C
	JR	NZ,M5E8D
	PUSH	BC
	LD	A,01H
	LD	(M37B6),A
	CALL	M42AA
	JR	NZ,M5E90
	POP	BC
	INC	E
	LD	A,E
	SUB	0AH
	JR	NZ,M5E8D
	LD	E,A
	INC	D
M5E8D	LD	A,(BC)
	EXX
	RET
M5E90	LD	HL,M42F1
M5E93	CALL	M429A
	CALL	M0040
	HALT
	PUSH	HL
M5E9B	LD	A,(HL)
	CP	03H
	JR	Z,M5EA8
	CALL	M0033
	INC	HL
	CP	0DH
	JR	NZ,M5E9B
M5EA8	POP	HL
	RET
	PUSH	BC
	CALL	M42B2
	POP	HL
	RET	Z
	LD	B,H
	LD	C,L
	LD	(M37EE),DE
	LD	HL,M37EC
	LD	(HL),1BH
	PUSH	AF
	POP	AF
	PUSH	AF
	POP	AF
M5EBF	LD	A,(HL)
	RRCA
	JR	C,M5EBF
	LD	(HL),88H
	PUSH	DE
	LD	DE,M37EF
	PUSH	BC
	POP	BC
	JR	M5ED8
M5ECD	RRCA
	JR	NC,M5EDA
M5ED0	LD	A,(HL)
	BIT	1,A
	JR	Z,M5ECD
	LD	A,(DE)
	LD	(BC),A
	INC	BC
M5ED8	JR	M5ED0
M5EDA	LD	A,(HL)
	AND	'\'
	POP	DE
	RET	Z
	LD	(HL),0D0H
	RET
	INC	E
	RRA
	INC	BC
	RLA
	RET	PE
	LD	C,(HL)
	LD	C,A
	JR	NZ,M5F3E
	LD	E,C
	LD	D,E
	LD	D,H
	LD	B,L
	LD	C,L
	DEC	C
	RLA
	RET	PE
	LD	B,H
	LD	C,C
	LD	D,E
	LD	C,E
	JR	NZ,M5F3E
	LD	D,D
	LD	D,D
	LD	C,A
	LD	D,D
	DEC	C
	EX	DE,HL

	; ask "DISKETTE CONTAINS DATA, FORAMT OR NOT ?"
	ORG	5B9CH
	LD	HL,M58FD
	CALL	M429A
	LD	HL,M5D00
	LD	B,01H
	CALL	M0040
	LD	A,(HL)
	CP	'N'
	JP	Z,M5BC0
	CP	'Y'
	JP	NZ,M5B9C
	NOP
	CALL	M5767
	LD	BC,M8000
	CALL	M0060
	RET

	LD	BC,M1000
	CALL	M0060
	JP	M56B0
M5F00	EQU	5F00H
M5F3E	EQU	5F3EH
M8000	EQU	8000H
MA100	EQU	0A100H
MEACB	EQU	0EACBH
MF397	EQU	0F397H
MF413	EQU	0F413H
MFF01	EQU	0FF01H
MFFFF	EQU	0FFFFH
	END	M5200
